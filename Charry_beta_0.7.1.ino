//Inprofed switch between modes
// a fucking ui (i hate my life)
//new clock 
//i am fucking tired
//its 3am..
//also a egg is in there
//clock works all the time so its fixed soon as u go out the time stops it will just keep on going now
//not like i will keep on going now
//actually proud T-T


const unsigned char senpai [] PROGMEM = {
  0x00, 0x00, 0x00, 0x00, 0x00, 0x00, 0x00, 0x00, 0x00, 0x00, 0x00, 0x00, 0x00, 0x00, 0x00, 0x00, 
  0x00, 0x00, 0x00, 0x00, 0x00, 0x00, 0x00, 0x00, 0x00, 0x00, 0x00, 0x00, 0x00, 0x00, 0x00, 0x00, 
  0x00, 0x00, 0x00, 0x00, 0x00, 0x00, 0x00, 0x00, 0x00, 0x00, 0x00, 0x00, 0x00, 0x00, 0x00, 0x00, 
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  0x00, 0x00, 0x00, 0x00, 0x00, 0x00, 0x00, 0x00, 0x03, 0x80, 0x00, 0x00, 0x00, 0x00, 0x00, 0x00
};


 const unsigned char face1 [] PROGMEM = {
  0x00, 0x00, 0x00, 0x00, 0x00, 0x00, 0x00, 0x00, 0x00, 0x00, 0x00, 0x00, 0x00, 0x00, 0x00, 0x00, 
  0x00, 0x00, 0x00, 0x00, 0x00, 0x00, 0x00, 0x00, 0x00, 0x00, 0x00, 0x00, 0x00, 0x00, 0x00, 0x00, 
  0x00, 0x00, 0x00, 0x00, 0x00, 0x00, 0x00, 0x00, 0x00, 0x00, 0x00, 0x00, 0x00, 0x00, 0x00, 0x00, 
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  0x00, 0x00, 0x00, 0x00, 0x00, 0x00, 0x00, 0x00, 0x00, 0x00, 0x00, 0x00, 0x00, 0x00, 0x00, 0x00
};

const unsigned char face2 [] PROGMEM = {
  0x00, 0x00, 0x00, 0x00, 0x00, 0x00, 0x00, 0x00, 0x00, 0x00, 0x00, 0x00, 0x00, 0x00, 0x00, 0x00, 
  0x00, 0x00, 0x00, 0x00, 0x00, 0x00, 0x00, 0x00, 0x00, 0x00, 0x00, 0x00, 0x00, 0x00, 0x00, 0x00, 
  0x00, 0x00, 0x00, 0x00, 0x00, 0x00, 0x00, 0x00, 0x00, 0x00, 0x00, 0x00, 0x00, 0x00, 0x00, 0x00, 
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  0x00, 0x00, 0x00, 0x00, 0x00, 0x00, 0x00, 0x00, 0x00, 0x00, 0x00, 0x00, 0x00, 0x00, 0x00, 0x00
};
const unsigned char face3 [] PROGMEM = {
  0x00, 0x00, 0x00, 0x00, 0x00, 0x00, 0x00, 0x00, 0x00, 0x00, 0x00, 0x00, 0x00, 0x00, 0x00, 0x00, 
  0x00, 0x00, 0x00, 0x00, 0x00, 0x00, 0x00, 0x00, 0x00, 0x00, 0x00, 0x00, 0x00, 0x00, 0x00, 0x00, 
  0x00, 0x00, 0x00, 0x00, 0x00, 0x00, 0x00, 0x00, 0x00, 0x00, 0x00, 0x00, 0x00, 0x00, 0x00, 0x00, 
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  0x00, 0x00, 0x00, 0x00, 0x00, 0x00, 0x00, 0x00, 0x00, 0x00, 0x00, 0x00, 0x00, 0x00, 0x00, 0x00
};

const unsigned char face40 [] PROGMEM = {
  0x00, 0x00, 0x00, 0x00, 0x00, 0x00, 0x00, 0x00, 0x00, 0x00, 0x00, 0x00, 0x00, 0x00, 0x00, 0x00, 
  0x00, 0x00, 0x00, 0x00, 0x00, 0x00, 0x00, 0x00, 0x00, 0x00, 0x00, 0x00, 0x00, 0x00, 0x00, 0x00, 
  0x00, 0x00, 0x00, 0x00, 0x00, 0x00, 0x00, 0x00, 0x00, 0x00, 0x00, 0x00, 0x00, 0x00, 0x00, 0x00, 
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  0x00, 0x00, 0x00, 0x00, 0x00, 0x00, 0x00, 0x00, 0x00, 0x00, 0x00, 0x00, 0x00, 0x00, 0x00, 0x00
};

const unsigned char face4 [] PROGMEM = {
  0x00, 0x00, 0x00, 0x00, 0x00, 0x00, 0x00, 0x00, 0x00, 0x00, 0x00, 0x00, 0x00, 0x00, 0x00, 0x00, 
  0x00, 0x00, 0x00, 0x00, 0x00, 0x00, 0x00, 0x00, 0x00, 0x00, 0x00, 0x00, 0x00, 0x00, 0x00, 0x00, 
  0x00, 0x00, 0x00, 0x00, 0x00, 0x00, 0x00, 0x00, 0x00, 0x00, 0x00, 0x00, 0x00, 0x00, 0x00, 0x00, 
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  0x00, 0x00, 0x00, 0x00, 0x00, 0x00, 0x00, 0x00, 0x00, 0x00, 0x00, 0x00, 0x00, 0x00, 0x00, 0x00
};

#include <SPI.h>
#include <Wire.h>
#include <Adafruit_GFX.h>
#include <Adafruit_SSD1306.h>
#define OLED_RESET 4


#define UP_BUTTON 2
#define DOWN_BUTTON 3
#define SWITCH_BUTTON 4  

const unsigned long PADDLE_RATE = 33;
const unsigned long BALL_RATE = 16;
const uint8_t PADDLE_HEIGHT = 24;



#define SCREEN_WIDTH 128 // OLED display width, in pixels
#define SCREEN_HEIGHT 64 // OLED display height, in pixels

// Declaration for an SSD1306 display connected to I2C (SDA, SCL pins)
#define OLED_RESET     4 // Reset pin # (or -1 if sharing Arduino reset pin)
Adafruit_SSD1306 display(SCREEN_WIDTH, SCREEN_HEIGHT, &Wire, OLED_RESET);

void drawCourt();

uint8_t ball_x = 64, ball_y = 32;
uint8_t ball_dir_x = 1, ball_dir_y = 1;
unsigned long ball_update;

unsigned long paddle_update;
const uint8_t CPU_X = 12;
uint8_t cpu_y = 16;

const uint8_t PLAYER_X = 115;
uint8_t player_y = 16;



void setup() {

  Serial.begin(9600);
  display.clearDisplay();
 

  
    pinMode(LED_BUILTIN, OUTPUT);
    int zahl1;
  int zahl2;
  display.begin(SSD1306_SWITCHCAPVCC, 0x3C); //or 0x3D
  
  display.clearDisplay(); //for Clearing the display
  display.drawBitmap(0, 0, senpai, 128, 64, WHITE); // display.drawBitmap(x position, y position, bitmap data, bitmap width, bitmap height, color)
  display.display();
delay(2000);

    display.begin(SSD1306_SWITCHCAPVCC, 0x3C);

    
    display.display();
    unsigned long start = millis();

    pinMode(UP_BUTTON, INPUT);
    pinMode(DOWN_BUTTON, INPUT);
    pinMode(SWITCH_BUTTON, INPUT);
    digitalWrite(SWITCH_BUTTON,1);
    digitalWrite(UP_BUTTON,1);
    digitalWrite(DOWN_BUTTON,1);
    display.clearDisplay();
    drawCourt();

    while(millis() - start < 2000);

    display.display();

    ball_update = millis();
    paddle_update = ball_update;
}

void loop() {
clocke2();
  if(digitalRead(SWITCH_BUTTON)==LOW){
   frie();
  }
  if(digitalRead(SWITCH_BUTTON)==HIGH){
    game();    
  }
  
 

  
}
int counter_1clock=0;
int counter0clock=0;
int counter1clock=0;
int counter2clock=0;

void RGame(){
  digitalWrite(LED_BUILTIN, HIGH);   
  delay(1000);                       
  digitalWrite(LED_BUILTIN, LOW);    
  delay(1000);  
  delay(200);

  int temp = 0;
int temp2 = 0;
int reset = 0;
int zahl = 0;
long startZeit = 0;
boolean win = false;
boolean vorherdruck = false;
int playerWin = 0;

Serial.begin(9600);
  randomSeed(analogRead(0));
  zahl = random(1000, 6001);
  Serial.println(zahl);


  
 for(;;){ 
  clocke2();
if(digitalRead(SWITCH_BUTTON)==HIGH){
    io();      
  }
if (millis() < zahl + startZeit && vorherdruck == false) {
    digitalWrite(LED_BUILTIN, HIGH);
    display.clearDisplay();
display.setTextSize(4);
display.setTextColor(WHITE);
display.setCursor(10,20);
    display.print("Wait");
    display.display();
  
  }

if (millis() > zahl + startZeit && vorherdruck == false) {
    digitalWrite(LED_BUILTIN, HIGH);
    display.clearDisplay();
display.setTextSize(4);
display.setTextColor(WHITE);
display.setCursor(10,20);
    display.print("Go!");
    display.display();
  
  }


if(digitalRead(3)==true && millis() > zahl + startZeit && vorherdruck == false){
Serial.println(millis() - startZeit - zahl);
display.clearDisplay();
display.setTextSize(3);
display.setTextColor(WHITE);
display.setCursor(1,20);
display.print(millis() - startZeit - zahl);
display.print("ms");
display.display();
delay(300);
reset = 1;
  }
if (digitalRead(3) == HIGH && millis() < zahl + startZeit && win == false) {
    digitalWrite(4, HIGH);
    vorherdruck = true;
reset = 1;
display.clearDisplay();
display.setTextSize(2);
display.setTextColor(WHITE);
display.setCursor(1,20);
    display.print("To early!");
    display.display();
    delay(200);
    reset=1;  
  }
  
  if (reset == 1) {
    digitalWrite(3, LOW);
    
    zahl = random(1000, 6001);
    win = false;
    vorherdruck = false;
    playerWin = 0;
    reset = 0;
    startZeit = millis();
    Serial.println(zahl);
  }


 }


  
  }
  int selection = 1;
void io(){
  delay(200);

display.clearDisplay();
display.setTextSize(1);
display.setTextColor(WHITE);
display.setCursor(1,20);
display.println("Charry");
display.println("Pong");
display.println("R-game");
display.println("Clock");
display.display();

for(;;){
  clocke2();
if(selection == 1){
display.clearDisplay();
display.setTextSize(2);
display.setTextColor(WHITE);
display.setCursor(1,1);
display.println("Charry   +");
display.println("Pong");
display.println("R-game");
display.println("Clock");
display.display();  
}
if(selection == 2){
display.clearDisplay();
display.setTextSize(2);
display.setTextColor(WHITE);
display.setCursor(1,1);
display.println("Charry");
display.println("Pong     +");
display.println("R-game");
display.println("Clock");
display.display();  
}
if(selection == 3){
display.clearDisplay();
display.setTextSize(2);
display.setTextColor(WHITE);
display.setCursor(1,1);
display.println("Charry");
display.println("Pong");
display.println("R-game   +");
display.println("Clock");

display.display();  
}
if(selection == 4){
display.clearDisplay();
display.setTextSize(2);
display.setTextColor(WHITE);
display.setCursor(1,1);
display.println("Charry");
display.println("Pong");
display.println("R-game");
display.println("Clock    +");
display.display();  
}

if(digitalRead(3)==HIGH){
  selection++;
  delay(200);
}
if(selection == 5){
  selection = 1;
}
if((digitalRead(2) && digitalRead(3) && digitalRead(4)== HIGH) && selection == 4){
  delay(200);
  for(;;){
display.clearDisplay();
display.setTextSize(2);
display.setTextColor(WHITE);
display.setCursor(1,1);
display.print(millis());
display.println("ms");
display.setTextSize(0);

display.println("what in gods name are u doing here? \n go away!");

clocke2();
if(digitalRead(3)&&digitalRead(2)==HIGH){
display.println("Stop pessing my boobs! \nSebpai >/////<");
}
display.display();
  if(digitalRead(4)==HIGH){
    io();
    
  }
}
}
if(digitalRead(2)==HIGH){
  
  if(selection==1){
frie();   
  }
    if(selection==2){
game();   
  }
    if(selection==3){
RGame(); 
  }
  if(selection==4){
clocke(); 
  }
}

  
}
}
unsigned long waiteruntil100 = 0;

void clocke2(){
if(millis()>=waiteruntil100){
  waiteruntil100=waiteruntil100+100;

counter_1clock++;
}
if(counter_1clock==10){
  counter0clock++;
  counter_1clock=0;
}
if(counter0clock>=60){
  counter1clock++;
  counter0clock=0;
}

if(counter2clock>12){
  counter2clock=0;
  }
  
}



void clocke(){
 digitalWrite(LED_BUILTIN, HIGH); 
  for(int i = 0; i<1000; i++){
    delay(1);
    clocke2();
   }                     
  digitalWrite(LED_BUILTIN, LOW);  

  
 for(;;){ 
if(digitalRead(SWITCH_BUTTON)==HIGH){
    io();  
  }

  
display.clearDisplay();
display.setTextSize(3);
display.setTextColor(WHITE);
display.setCursor(1,20);
display.print(counter2clock);
display.print(":");
display.print(counter1clock);
display.print(":");
display.print(counter0clock);
display.display();





if(digitalRead(UP_BUTTON)==HIGH){
counter1clock++;
}
if(counter1clock==60){
  counter1clock=0;
  counter2clock++;
  if(counter2clock==13){
    counter2clock=0;
  }
}

if(digitalRead(DOWN_BUTTON)==HIGH){
counter1clock--;
if(counter1clock==-1){
  counter1clock=59;
  counter2clock--;
  if(counter2clock==-1){
    counter2clock=12;
  }
}
}
clocke2();
  
   }
  

  
}




  

void frie(){
  
  digitalWrite(LED_BUILTIN, HIGH); 
  for(int i = 0; i<1000; i++){
    delay(1);
    clocke2();
   }                     
  digitalWrite(LED_BUILTIN, LOW);  


  
  for(;;){
  clocke2();
int zahl1;
  int zahl2;
  
  display.clearDisplay(); //for Clearing the display
  display.drawBitmap(0, 0, face1, 128, 64, WHITE); // display.drawBitmap(x position, y position, bitmap data, bitmap width, bitmap height, color)
  display.display();

  for(int ia = 0; ia<2000;ia++){
  if(digitalRead(SWITCH_BUTTON)==HIGH){
    io();  
      
  }
  clocke2();
  delay(1);
  }
//delay(2000);

for(zahl1=1; zahl1<=50; zahl1++){
  display.clearDisplay(); //for Clearing the display
  display.drawBitmap(0, 0, face3, 128, 64, WHITE); // display.drawBitmap(x position, y position, bitmap data, bitmap width, bitmap height, color)
  display.display();
  for(int ib = 0; ib<6000;ib++){
  if(digitalRead(SWITCH_BUTTON)==HIGH){
    io(); 
          
  }
  clocke2();
  delay(1);
  }
//delay(6000);

  display.clearDisplay(); //for Clearing the display
  display.drawBitmap(0, 0, face2, 128, 64, WHITE); // display.drawBitmap(x position, y position, bitmap data, bitmap width, bitmap height, color)
  display.display();
  for(int ic = 0; ic<1000;ic++){
  if(digitalRead(SWITCH_BUTTON)==HIGH){
   io();  
        
  }
  clocke2();
  delay(1);
  }
//delay(1000);
}  //for end
for(zahl2=1; zahl2<=25; zahl2++){
  display.clearDisplay(); //for Clearing the display
  display.drawBitmap(0, 0, face40, 128, 64, WHITE); // display.drawBitmap(x position, y position, bitmap data, bitmap width, bitmap height, color)
  display.display();
  for(int id = 0; id<1000;id++){
  if(digitalRead(SWITCH_BUTTON)==HIGH){
    io(); 
          
  }
  clocke2();
  delay(1); 
  }
//delay(1000);
  
  display.clearDisplay(); //for Clearing the display
  display.drawBitmap(0, 0, face4, 128, 64, WHITE); // display.drawBitmap(x position, y position, bitmap data, bitmap width, bitmap height, color)
  display.display();
  for(int ie = 0; ie<1000;ie++){
  if(digitalRead(SWITCH_BUTTON)==HIGH){
    io();    
        
  }
  clocke2();
  delay(1); 
  }
//delay(1000);
}//for end

  }
  
}

void game() {
  
  display.clearDisplay();
  
  
    for(;;){
      if(digitalRead(SWITCH_BUTTON)==HIGH){
  io();    
  }
    clocke2();  
      
  

     bool update = false;
    unsigned long time = millis();

    static bool up_state = false;
    static bool down_state = false;
    
    up_state |= (digitalRead(UP_BUTTON) == LOW);
    down_state |= (digitalRead(DOWN_BUTTON) == LOW);

    if(time > ball_update) {
        uint8_t new_x = ball_x + ball_dir_x;
        uint8_t new_y = ball_y + ball_dir_y;

        // Check if we hit the vertical walls
        if(new_x == 0 || new_x == 127) {
            ball_dir_x = -ball_dir_x;
            new_x += ball_dir_x + ball_dir_x;
        }

        // Check if we hit the horizontal walls.
        if(new_y == 0 || new_y == 63) {
            ball_dir_y = -ball_dir_y;
            new_y += ball_dir_y + ball_dir_y;
        }

        // Check if we hit the CPU paddle
        if(new_x == CPU_X && new_y >= cpu_y && new_y <= cpu_y + PADDLE_HEIGHT) {
            ball_dir_x = -ball_dir_x;
            new_x += ball_dir_x + ball_dir_x;
        }

        // Check if we hit the player paddle
        if(new_x == PLAYER_X
           && new_y >= player_y
           && new_y <= player_y + PADDLE_HEIGHT)
        {
            ball_dir_x = -ball_dir_x;
            new_x += ball_dir_x + ball_dir_x;
        }

        display.drawPixel(ball_x, ball_y, BLACK);
        display.drawPixel(new_x, new_y, WHITE);
        ball_x = new_x;
        ball_y = new_y;

        ball_update += BALL_RATE;

        update = true;
    }

    if(time > paddle_update) {
        paddle_update += PADDLE_RATE;

        // CPU paddle
        display.drawFastVLine(CPU_X, cpu_y, PADDLE_HEIGHT, BLACK);
        const uint8_t half_paddle = PADDLE_HEIGHT >> 1;
        if(cpu_y + half_paddle > ball_y) {
            cpu_y -= 1;
        }
        if(cpu_y + half_paddle < ball_y) {
            cpu_y += 1;
        }
        if(cpu_y < 1) cpu_y = 1;
        if(cpu_y + PADDLE_HEIGHT > 63) cpu_y = 63 - PADDLE_HEIGHT;
        display.drawFastVLine(CPU_X, cpu_y, PADDLE_HEIGHT, WHITE);

        // Player paddle
        display.drawFastVLine(PLAYER_X, player_y, PADDLE_HEIGHT, BLACK);
        if(up_state) {
            player_y -= 1;
        }
        if(down_state) {
            player_y += 1;
        }
        up_state = down_state = false;
        if(player_y < 1) player_y = 1;
        if(player_y + PADDLE_HEIGHT > 63) player_y = 63 - PADDLE_HEIGHT;
        display.drawFastVLine(PLAYER_X, player_y, PADDLE_HEIGHT, WHITE);

        update = true;
    }

    if(update)
        display.display();


   
    }
  
  }
  

void drawCourt() {
   // display.drawRect(0, 0, 128, 64, WHITE);
}
